## drivers/can/Kconfig.ipc
```kconfig
# CAN IPC driver configuration options

# Copyright (c) 2019 Alexander Wachter
# Copyright (c) 2026 Dmitrii Sharshakov
# SPDX-License-Identifier: Apache-2.0

config CAN_IPC
	bool "CAN over IPC"
	default y
	select IPC_SERVICE
	select MBOX
	depends on DT_HAS_ZEPHYR_CAN_IPC_ENABLED
	help
	  This driver passes messages to a controller over IPC.

if CAN_IPC

config CAN_IPC_MAX_FILTERS
	int "Maximum number of concurrent active filters"
	default 16
	range 1 1024
	help
	  Defines the array size of the filters.
	  Must be at least the size of concurrent reads.

config CAN_IPC_TX_THREAD_STACK_SIZE
	int "TX thread stack size"
	default 512
	help
	  Stack size of the TX thread.
	  The TX thread calls the callbacks of the receiver
	  if the filter matches.

config CAN_IPC_TX_THREAD_PRIORITY
	int "TX thread priority"
	default 2
	help
	  Priority of the TX thread.
	  The TX thread calls the callbacks of the receiver
	  if the filter matches.

config CAN_IPC_TX_MSGQ_SIZE
	int "TX message queue size"
	default 16
	help
	  Number of TX frames that can be buffered.
	  The send functions puts frame int this queue and TX thread takes the
	  messages from this msgq and calls the respective receiver if the
	  filter matches.

endif # CAN_IPC
```

## dts/bindings/can/zephyr,can-ipc.yaml
```yaml
# Copyright (c) 2026 Dmitrii Sharshakov
# SPDX-License-Identifier: Apache-2.0

description: CAN controller connected via IPC

compatible: "zephyr,can-ipc"

include: can-controller.yaml
```
