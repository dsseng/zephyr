## boards/raspberrypi/rpi_pico2/Kconfig.defconfig
```kconfig
# Copyright (c) 2024 Andrew Featherstone
# SPDX-License-Identifier: Apache-2.0

if BOARD_RPI_PICO2

config USB_SELF_POWERED
	default n

if WIFI_AIROC

choice AIROC_PART
	default CYW43439
endchoice

config WHD_DISABLE_SDIO_PULLUP_DURING_SPI_SLEEP
	default y

endif # WIFI_AIROC

endif # BOARD_RPI_PICO2

if BOARD_RPI_PICO2_RP2350A_M33_CPU1

source "boards/common/usb/Kconfig.cdc_acm_serial.defconfig"

endif # BOARD_RPI_PICO2_RP2350A_M33_CPU1
```

## drivers/can/Kconfig.can2040
```kconfig
# can2040 configuration options

# Copyright (c) 2025 Dmitrii Sharshakov <d3dx12.xx@gmail.com>
# SPDX-License-Identifier: Apache-2.0

config CAN_CAN2040
	bool "can2040 PIO-based driver (external)"
	default y
	depends on DT_HAS_CAN2040_CAN2040_ENABLED
	help
	  This enables support for can2040 CAN driver, based on RP2 PIO, using an external library.
```

## modules/can2040/Kconfig
```kconfig
# Copyright (c) 2025 Dmitrii Sharshakov
# SPDX-License-Identifier: Apache-2.0

config ZEPHYR_CAN2040_MODULE
	bool
```

## samples/bluetooth/bap_unicast_server/boards/native_sim.conf
```kconfig
CONFIG_LOG_MODE_IMMEDIATE=y

CONFIG_LIBLC3=y
CONFIG_FPU=y

# For LE-audio at 10ms intervals we need the tick counter to occur more frequently
# than every 10 ms as each PDU for some reason takes 2 ticks to process.
CONFIG_SYS_CLOCK_TICKS_PER_SEC=1000
CONFIG_NATIVE_SIM_SLOWDOWN_TO_REAL_TIME=y

CONFIG_BT_SETTINGS=y
CONFIG_FLASH=y
CONFIG_FLASH_PAGE_LAYOUT=y
CONFIG_FLASH_MAP=y
CONFIG_NVS=y
CONFIG_SETTINGS=y
```

## samples/subsys/ipc/ipc_service/multi_endpoint/Kconfig.sysbuild
```kconfig
# Copyright 2023 Nordic Semiconductor ASA
#
# SPDX-License-Identifier: Apache-2.0

source "share/sysbuild/Kconfig"

config NET_CORE_BOARD
string
	default "nrf5340dk/nrf5340/cpunet" if $(BOARD) = "nrf5340dk"
	default "nrf5340bsim/nrf5340/cpunet" if $(BOARD) = "nrf5340bsim"
	default "rpi_pico2/rp2350a/m33_cpu1" if $(BOARD) = "rpi_pico2"
```

## tests/subsys/ipc/ipc_sessions/Kconfig.sysbuild
```kconfig
#
# Copyright (c) 2024 Nordic Semiconductor ASA
#
# SPDX-License-Identifier: Apache-2.0
#

source "${ZEPHYR_BASE}/share/sysbuild/Kconfig"

config REMOTE_BOARD
	string "The board used for remote target"
	default "nrf5340dk/nrf5340/cpunet" if BOARD_NRF5340DK_NRF5340_CPUAPP
	default "nrf5340dk/nrf5340/cpunet" if BOARD_NRF5340DK_NRF5340_CPUAPP_NS
	default "nrf54h20dk/nrf54h20/cpurad" if BOARD_NRF54H20DK_NRF54H20_CPUAPP
	default "rpi_pico2/rp2350a/m33_cpu1" if BOARD_RPI_PICO2_RP2350A_M33_CPU0
```
