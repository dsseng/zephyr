/*
 * Copyright (c) 2025 Dmitrii Sharshakov
 *
 * SPDX-License-Identifier: Apache-2.0
 */

 /delete-node/ &sram0;

/ {
	soc {
		sram0_cpu0: memory@20000000 {
			compatible = "mmio-sram";
			reg = <0x20000000 DT_SIZE_K(256)>;
		};

		sram0_cpu1: memory@20040000{
			compatible = "mmio-sram";
            // Assign 2x4KB SRAM blocks to CPU1 due to adjacency
			reg = <0x20040000 DT_SIZE_K(264)>;
		};
	};
};

// TODO: partitions for flash
