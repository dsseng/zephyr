/*
 * Copyright 2025 Dmitrii Sharshakov <d3dx12.xx@gmail.com>
 *
 * SPDX-License-Identifier: Apache-2.0
 */

/ {
	chosen {
		zephyr,canbus = &can0;
	};
};

&can_loopback0 {
	status = "disabled";
};

&can0 {
	status = "okay";
	host-interface = "vcan0";
};
